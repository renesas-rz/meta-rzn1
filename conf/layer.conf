## conf/layer.conf
```bitbake
# We have a conf and classes directory, append to BBPATH
BBPATH .= ":${LAYERDIR}"

# We have a recipes directory, add to BBFILES
BBFILES += "${LAYERDIR}/recipes*/*/*.bb ${LAYERDIR}/recipes*/*/*.bbappend"

BBFILE_COLLECTIONS += "meta-rzn1"
BBFILE_PATTERN_meta-rzn1 := "^${LAYERDIR}/"
# increase the number 
BBFILE_PRIORITY_meta-rzn1 = "6"

# yves
BBDEBUG = "yes"

LAYERSERIES_COMPAT_meta-rzn1 = "dunfell rocko"
```

## conf/machine/include/rzn1.inc
```bitbake
SOC_FAMILY = "rzn1"

# Cortex A7, thumb, hard float, VPFv4-d16
DEFAULTTUNE ?= "armv7vethf-vfpv4d16"
require conf/machine/include/tune-cortexa7.inc

# this variable specifies the kernel to be built
# this affects the PREFERRED_PROVIDER of virtual/kernel
# it can be overriden from the environment, using BB_ENV_EXTRAWHITE
KERNEL_PROVIDER ?= "linux-rzn1"
PREFERRED_PROVIDER_virtual/kernel = "${KERNEL_PROVIDER}"

PREFERRED_PROVIDER_virtual/bootloader = "u-boot-rzn1"

# Increase this everytime you change something in the kernel
MACHINE_KERNEL_PR = "r1"

UBOOT_ENTRYPOINT ?= "0x80008000"
UBOOT_LOADADDRESS ?= "0x80008000"

SERIAL_CONSOLE ?= "115200 ttyS0"

KERNEL_IMAGETYPE ?= "uImage"
KERNEL_EXTRA_ARGS += "LOADADDR=${UBOOT_ENTRYPOINT}"

MACHINE_EXTRA_RRECOMMENDS = " kernel-modules kernel-devicetree"

# We want PCI just because USB Host is behind a PCI bridge
MACHINE_FEATURES += " pci usbgadget usbhost vfat"

# file system images required
IMAGE_FSTYPES ?= "tar.bz2 squashfs"

# Provide RZ/N1 specifics
OVERRIDES += ":rzn1"
```

## conf/machine/rzn1d400-db.conf
```bitbake
#@TYPE: Machine
#@NAME: rzn1d400-db
#@DESCRIPTION: Machine configuration for the Renesas RZ/N1D DB Demo board"

UBOOT_MACHINE_rzn1d400-db = "rzn1d400-db_config"
KERNEL_DEVICETREE ?= "rzn1d400-db.dtb"

require conf/machine/include/rzn1.inc
```
